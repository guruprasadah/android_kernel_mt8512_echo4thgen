/*
 * Copyright (c) 2020 Amazon.com
 *
 * SPDX-License-Identifier: (GPL-2.0)
 */

/dts-v1/;
#include "scooter.dtsi"

/ {
	model = "Amazon Scooter";
	compatible = "amzn,scooter-p55", "mediatek,mt8512";

	chosen {
		bootargs = "";
	};
};
