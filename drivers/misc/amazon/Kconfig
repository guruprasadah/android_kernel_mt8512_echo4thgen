## drivers/misc/amazon/Kconfig
```kconfig
#
# Amazon Devices
#
config ACEWFSTA
	tristate "ACEWFSTA"
	default n
	help
	  This option enables support the ACEWFSTA accelerator.
	  If you are not sure, say N here.

config ACENNA
	tristate "ACENNA"
	default n
	help
	  This option enables support the ACENNA accelerator.
	  If you are not sure, say N here.

source "drivers/misc/amazon/dsp/Kconfig"
```

## drivers/misc/amazon/dsp/Kconfig
```kconfig
config AMAZON_DSP_FW_LOAD
	tristate "Amazon DSP FW Load"
	default n

	help
        Amazon DSP FW Load

config I2C_ADSP_IPI
	tristate "Psuedo I2C over IPI Driver"
	default n
	help
	  This selects the Psuedo I2C bus driver to access I2C over IPI for DSP is master
	  If unsure, say N.
```

## drivers/misc/mediatek/2dgfx/Kconfig
```kconfig
config MTK_2DGFX
  bool "enable MTK 2DGFX Driver"
  help
     This enable MTK GFX driver.
```

## drivers/misc/mediatek/gpt_rtc/Kconfig
```kconfig
#
# GPT as RTC driver configuration
#

config RTC_DRV_GPT
	tristate "Mediatek APXGPT as RTC driver"
	depends on RTC_LIB && !RTC_HCTOSYS
	help
	  This selects Mediatek APXGPT as RTC driver due to some platforms
	  havn't RTC hardware.
	  This solution has some limitations:
	  1. cannot support set_time
	  2. APXGPT needs use 32K(32768) clock source
	  3. cannot support HCTOSYS feature
	  If you want to use Mediatek APXGPT as RTC interface,
	  select Y or M here
```

## drivers/misc/mediatek/hifi4dsp_load/Kconfig
```kconfig
#
# MediaTek HIFI4DSP SPI and Load Driver
#

config MTK_HIFI4DSP_SUPPORT
	bool "Mediatek HIFI4DSP SPI and Load Driver"
	default n
	---help---
	  Enables to support HIFI4DSP bootup at linux kernel stage with SPI communication.
	  If unsure, say N.

config MTK_HIFI4DSP_CHECK_DSP_DVFS
	bool "Mediatek HIFI4DSP SPI check DSP CLK Status"
	depends on MTK_HIFI4DSP_SUPPORT
	default n
	---help---
	  Enables to support HIFI4DSP bootup at linux kernel stage with SPI communication.
	  If unsure, say N.
```

## drivers/misc/mediatek/hwtcon/Kconfig
```kconfig
config MTK_HWTCON
	bool "build HWTCON driver"
	help
	    This HWTCON module is used for drive electronic ink screen show picture.
		    HWTCON will convert Y4 format input picture to electronic conversion signal,
		    which will drive ink screen show input picture.
```

## drivers/misc/mediatek/sleep_eint/Kconfig
```kconfig
#
# MediaTek Sleep EINT support
#

config MTK_SLEEP_EINT_SUPPORT
	bool "Mediatek Sleep EINT Support"
	---help---
	  Enables to support sleep controlled by gpio input.
	  If unsure, say N.
```

## drivers/misc/mediatek/spi_slave/Kconfig
```kconfig
# Spi Slave driver configuration
menuconfig MTK_SPI_SLAVE
	bool "MediaTek SPI SLAVE support"
	default n
	---help---
	  This selects the MediaTek(R) Spi Slave device driver.
	  If you want to use MediaTek(R) Spi Slave device driver,
	  say Y or M here.If unsure, say N.

config MTK_SPI_SLAVE_MT85XX
	tristate "MediaTek SPI SLAVE controller"
	depends on MTK_SPI_SLAVE
	default n
	---help---
	  This selects the Spi Slave device driver for Mediatek MT85XX series ARM SoCs.
	  If you want to use MediaTek(R) Spi Slave interface, say Y or M here.
	  If you are not sure, say N.
```

## drivers/net/halo/Kconfig
```kconfig
config HALO_NET
	bool "Amazon Halo network driver"
	default n
	help
	  Select this option to enable the Halo network driver.

config HALO_NET_SPI
	bool "Amazon Halo network driver SPI interface"
	default n
	help
	  Select this option if the interface is a SPI.

config HALO_NET_SPI_BUS_NUM
	int "SPI bus number which is connected with nRF MCU"
	depends on HALO_NET_SPI
	range 0 32768
	default 0
	help
	  This option overrides SPI CS_SETUP and CS_HOLD offset values as optimum
	  for the SPI bus number which is connected with nRF MCU in order to achieve
	  the maximun supported speed (8MHz) from nRF MCU.

	  Examples:
	    32766 => spi0: spi@1100a000
	    32765 => spi1: spi@11010000
	    32764 => spi2: spi@11012000
	    32763 => spi3: spi@11013000
	    32762 => spi4: spi@11018000
	    32761 => spi5: spi@11019000

config HALO_NET_UART
	bool "Amazon Halo network driver UART interface"
	default n
	help
	  Select this option if the interface is a UART.
```

## drivers/phy/mediatek/Kconfig
```kconfig
#
# Phy drivers for MediaTek devices
#
config PHY_MTK_TPHY
    tristate "MediaTek T-PHY Driver"
    depends on ARCH_MEDIATEK && OF
    select GENERIC_PHY
    help
      Enable this to add support for MediaTek T-PHY driver,
      it supports physical layer functionality for usb2.0, usb3.0,
      PCIe and SATA, and meanwhile supports two version T-PHY which
      have different banks layout, the T-PHY with shared banks between
      multi-ports is first version, otherwise is second veriosn,
      so you can easily distinguish them by banks layout.
```

## drivers/tee/optee/Kconfig
```kconfig
# OP-TEE Trusted Execution Environment Configuration
config OPTEE
	tristate "OP-TEE"
	depends on HAVE_ARM_SMCCC
	help
	  This implements the OP-TEE Trusted Execution Environment (TEE)
	  driver.

config OPTEE_REE_CONSOLE
	tristate "OP-TEE REE Console"
	default y
	depends on OPTEE
	help
	  This implements the mechanism to accept log from OP-TEE RPC.

config OPTEE_REE_CLK_CTRL
	tristate "OP-TEE REE Clock Control"
	default y
	depends on OPTEE && OF
	help
	  This implements the mechanism to control clock by request from
	  OP-TEE RPC.
```
