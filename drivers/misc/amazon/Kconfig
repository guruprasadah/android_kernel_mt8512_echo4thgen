## sound/soc/mediatek/Kconfig
```kconfig
config SND_SOC_MEDIATEK
	tristate

config SND_SOC_MT2701
	tristate "ASoC support for Mediatek MT2701 chip"
	depends on ARCH_MEDIATEK
	select SND_SOC_MEDIATEK
	help
	  This adds ASoC driver for Mediatek MT2701 boards
	  that can be used with other codecs.
	  Select Y if you have such device.
	  If unsure select "N".

config SND_SOC_MT2701_CS42448
	tristate "ASoc Audio driver for MT2701 with CS42448 codec"
	depends on SND_SOC_MT2701 && I2C
	select SND_SOC_CS42XX8_I2C
	select SND_SOC_BT_SCO
	help
	  This adds ASoC driver for Mediatek MT2701 boards
	  with the CS42448 codecs.
	  Select Y if you have such device.
	  If unsure select "N".

config SND_SOC_MT2712_D1V1
	tristate "ASoc Audio driver for MT2712 with D1V1 DTB"
	depends on SND_SOC_MT2701
	select SND_SOC_BT_SCO
	help
	  This adds ASoC driver for Mediatek MT2701 boards
	  with the MTKD1V1 DTB.
	  Select Y if you have such device.
	  If unsure select "N".

config SND_SOC_MT8173
	tristate "ASoC support for Mediatek MT8173 chip"
	depends on ARCH_MEDIATEK
	select SND_SOC_MEDIATEK
	help
	  This adds ASoC platform driver support for Mediatek MT8173 chip
	  that can be used with other codecs.
	  Select Y if you have such device.
	  Ex: MT8173

config SND_SOC_MT8173_MAX98090
	tristate "ASoC Audio driver for MT8173 with MAX98090 codec"
	depends on SND_SOC_MT8173 && I2C
	select SND_SOC_MAX98090
	help
	  This adds ASoC driver for Mediatek MT8173 boards
	  with the MAX98090 audio codec.
	  Select Y if you have such device.
	  If unsure select "N".

config SND_SOC_MT8173_RT5650
	tristate "ASoC Audio driver for MT8173 with RT5650 codec"
	depends on SND_SOC_MT8173 && I2C
	select SND_SOC_RT5645
	select SND_SOC_HDMI_CODEC
	help
	  This adds ASoC driver for Mediatek MT8173 boards
	  with the RT5650 audio codec.
	  Select Y if you have such device.
	  If unsure select "N".

config SND_SOC_MT8173_RT5650_RT5514
	tristate "ASoC Audio driver for MT8173 with RT5650 RT5514 codecs"
	depends on SND_SOC_MT8173 && I2C
	select SND_SOC_RT5645
	select SND_SOC_RT5514
	help
	  This adds ASoC driver for Mediatek MT8173 boards
	  with the RT5650 and RT5514 codecs.
	  Select Y if you have such device.
	  If unsure select "N".

config SND_SOC_MT8173_RT5650_RT5676
	tristate "ASoC Audio driver for MT8173 with RT5650 RT5676 codecs"
	depends on SND_SOC_MT8173 && I2C
	select SND_SOC_RT5645
	select SND_SOC_RT5677
	select SND_SOC_HDMI_CODEC
	select SND_SOC_TLV320AIC3101
	help
	  This adds ASoC driver for Mediatek MT8173 boards
	  with the RT5650 and RT5676 codecs.
	  Select Y if you have such device.
	  If unsure select "N".

config SND_SOC_MT8518
	tristate "ASoC support for Mediatek MT8518 chip"
	select SND_SOC_MEDIATEK
	help
	  This adds ASoC platform driver support for Mediatek MT8518 chip
	  that can be used with other codecs.
	  Select Y if you have such device.
	  Ex: MT8158

config SND_SOC_MT8518_COMPRESS
	tristate "Compress offload support for Mediatek MT8518 chip"
	depends on MTK_HIFI4DSP_SUPPORT
	select SND_SOC_COMPRESS
	help
	  This adds Compress driver support for Mediatek MT8518 chip.
	  Only enable this when we have DSP.
	  Select Y if you need the compress feature.
	  If unsure select "N".

config SND_SOC_MT8516_abc123_MACH
	tristate "ASoC Audio driver for MT8516 abc123 board"
	depends on MACH_MT8167
	select SND_SOC_MT8167
	select SND_SOC_BT_SCO
	select SND_SOC_MT8167_CODEC
	select SND_SOC_TLV320AIC3101_DT
	select SND_SOC_TLV320AIC32X4
	help
	  This adds support for ASoC machine driver for abc123 board.
          It is related to BT SCO.
	  Select Y if you have such device.
	  If unsure select "N".

config SND_SOC_COMPRESS_NR_PLAYBACK_STREAMS
	int "Maximum number of compress playback streams"
	range 1 3
	default 1
	depends on MTK_HIFI4DSP_SUPPORT

config SND_SOC_MT8518_ADSP_PCM_PLAYBACK
	tristate "ADSP PCM playback support for Mediatek MT8518 chip"
	depends on MTK_HIFI4DSP_
	help
	  This adds ADSP PCM driver support for Mediatek MT8518 chip.
	  Only enable this when we have DSP.
	  Select Y if you need the pcm playback feature.
	  If unsure select "N".

config SND_SOC_MT8518_ADSP_VOICE_ASSIST
	tristate "ADSP voice assist support for Mediatek MT8518 chip"
	depends on MTK_HIFI4DSP_SUPPORT
	help
	  This adds ADSP voice asssit driver support for Mediatek MT8518 chip.
	  Only enable this when we have DSP.
	  Select Y if you need the pcm playback feature.
	  If unsure select "N".

config SND_SOC_MT8518_EVB
	tristate "ASoC Audio driver for MT8158 with internal codec"
	depends on SND_SOC_MT8518
	select SND_SOC_MT8518_CODEC
	help
	  This adds ASoC driver for Mediatek MT8518 boards
	  with the internal audio codec.
	  Select Y if you have such device.
	  If unsure select "N".

config SND_SOC_MT8518A_BROWNIE
	tristate "ASoC Audio driver for BROWNIE"
	depends on SND_SOC_MT8518
	select SND_SOC_MT8518_CODEC
	select SND_SOC_TLV320ADC5140
	select SND_SOC_TAS5805M
	help
	  This adds ASoC driver for Brownie board
	  with the internal audio codec and external dac, adc.
	  Select Y if you have such device.
	  If unsure select "N".

config SND_SOC_MT8518A_LASER
	tristate "ASoC Audio driver for LASER"
	depends on SND_SOC_MT8518
	select SND_SOC_MT8518_CODEC
	select SND_SOC_TLV320ADC5140
	select SND_SOC_TAS5805M
	select SND_SOC_TLV320ADC3100
	help
	  This adds ASoC driver for Laser board
	  with the internal audio codec and external dac, adc.
	  Select Y if you have such device.
	  If unsure select "N".

config SND_SOC_MT8516_abc123_MACH
	tristate "ASoC Audio driver for MT8516 abc123 board"
	depends on MACH_MT8167
	select SND_SOC_MT8167
	select SND_SOC_BT_SCO
	select SND_SOC_MT8167_CODEC
	select SND_SOC_TLV320AIC3101
	help
	  This adds support for ASoC machine driver for abc123 board.
          It is related to BT SCO.
	  Select Y if you have such device.
	  If unsure select "N".

config SND_SOC_MT8518A_P1
	tristate "ASoC Audio driver for MT8158 with RT9114 codec"
	depends on SND_SOC_MT8518
	select RT_REGMAP
	select SND_SOC_RT9114
	select SND_SOC_8_MICS
	help
	  This adds ASoC driver for Mediatek MT8518 boards
	  with the RT9114 codec.
	  Select Y if you have such device.
	  If unsure select "N".

config SND_SOC_MT8516_abc123_MACH
	tristate "ASoC Audio driver for MT8516 abc123 board"
	depends on MACH_MT8167
	select SND_SOC_MT8167
	select SND_SOC_BT_SCO
	select SND_SOC_MT8167_CODEC
	select SND_SOC_8_MICS
	select SND_SOC_TLV320AIC3101
	select SND_SOC_CS42526
	help
	  This adds support for ASoC machine driver for abc123 board.
          It is related to BT SCO.
	  Select Y if you have such device.
	  If unsure select "N".

config SND_SOC_MT8516_abc123_MACH
	tristate "ASoC Audio driver for MT8516 abc123 board"
	depends on MACH_MT8167
	select SND_SOC_MT8167
	select SND_SOC_BT_SCO
	select SND_SOC_MT8167_CODEC
	select SND_SOC_TLV320AIC32X4
	help
	  This adds support for ASoC machine driver for abc123 board.
	  It is related to BT SCO.
	  Select Y if you have such device.
	  If unsure select "N".

config SND_SOC_MT8516_abc123_MACH
	tristate "ASoC Audio driver for MT8516 abc123 board"
	depends on MACH_MT8167
	select SND_SOC_MT8167
	select SND_SOC_BT_SCO
	select SND_SOC_MT8167_CODEC
	help
	  This adds support for ASoC machine driver for abc123 board.
	  It is related to BT SCO.
	  Select Y if you have such device.
	  If unsure select "N".

config SND_SOC_MT8516_abc123_MACH
	tristate "ASoC Audio driver for MT8516 abc123 board"
	depends on MACH_MT8167
	select SND_SOC_MT8167
	select SND_SOC_BT_SCO
	select SND_SOC_MT8167_CODEC
	help
	  This adds support for ASoC machine driver for abc123 board.
	  It is related to BT SCO.
	  Select Y if you have such device.
	  If unsure select "N".

config SND_SOC_MT8518B_P1
	tristate "ASoC Audio driver for MT8158 with internal codec"
	depends on SND_SOC_MT8518
	select SND_SO
	help
	  This adds ASoC driver for Mediatek MT8518 boards
	  with the internal audio codec.
	  Select Y if you have such device.
	  If unsure select "N".

config SND_SOC_MT8512
	tristate "ASoC support for Mediatek MT8512 chip"
	depends on ARCH_MEDIATEK
	select SND_SOC_MEDIATEK
	help
	  This adds ASoC platform driver support for Mediatek MT8512 chip
	  that can be used with other codecs.
	  Select Y if you have such device.
	  Ex: MT8512

config SND_SOC_MT8512_ADSP_PCM_PLAYBACK
	tristate "ADSP PCM playback support for Mediatek MT8512 chip"
	depends on MTK_HIFIXDSP_SUPPORT
	help
	  This adds ADSP PCM driver support for Mediatek MT8512 chip.
	  Only enable this when we have DSP.
	  Select Y if you need the pcm playback feature.
	  If unsure select "N".

config SND_SOC_MT8512_EVB
	tristate "ASoC Audio driver for MT8512 EVB Board"
	depends on SND_SOC_MT8512
	select SND_SOC_MT8512_CODEC
	select SND_SOC_TLV320WN
	help
	  This adds support for ASoC machine driver for Mediatek MT8512.
	  Select Y if you have such device.
	  If unsure select "N".
	  Ex: MT8512

config SND_SOC_MT8512_FPGA
	tristate "ASoC Audio driver for MT8512 Early Porting"
	depends on SND_SOC_MT8512
	help
	  This adds ASoC driver for Mediatek MT8512 FPGA boards
	  Select Y if you have such device.
	  If unsure select "N".
	  Ex: MT8512

config SND_SOC_MT8512B_BROWNIE
	tristate "ASoC Audio driver for MT8512B Brownie Board"
	depends on SND_SOC_MT8512
	select SND_SOC_MT8512_CODEC
	select SND_SOC_TLV320ADC5140
	select SND_SOC_AK5704
	select SND_SOC_ES7210
	select SND_SOC_TAS5805M
	select SND_SOC_MAX98396
	help
	  This adds support for ASoC machine driver for Mediatek MT8512.
	  Select Y if you have such device.
	  If unsure select "N".
	  Ex: MT8512

config SND_SOC_MT8512B_LASER
	tristate "ASoC Audio driver for MT8512B Laser Board"
	depends on SND_SOC_MT8512
	select SND_SOC_MT8512_CODEC
	select SND_SOC_TLV320ADC5140
	select SND_SOC_TAS5805M
	help
	  This adds support for ASoC machine driver for Mediatek MT8512.
	  Select Y if you have such device.
	  If unsure select "N".
	  Ex: MT8512

config SND_SOC_MT8512B_P1
	tristate "ASoC Audio driver for MT8512B P1 Board"
	depends on SND_SOC_MT8512
	select SND_SOC_MT8512_CODEC
	help
	  This adds support for ASoC machine driver for Mediatek MT8512.
	  Select Y if you have such device.
	  If unsure select "N".
	  Ex: MT8512

config SND_SOC_GAPP_AUDIO_CONTROL
	bool "GAPP Audio Control Support"
	default n
	help
	  This adds audio controls for Mediatek boards
	  with the GAPP feature support.
	  Select Y if you have such feature.
	  If unsure select "N".

config MTK_SND_SOC_CODEC
	string "String for Mediatek audio codec"
	help
	  Specify Mediatek audio codec.
	  It depend on the string to choose the audio codec.
	  Say "mt6351" if you have mt6351 audio codec.
	  Say "mt6337" if you have mt6337 audio codec.
	  Say "mt6355" if you have mt6355 audio codec.

config MTK_SPEAKER
	bool "MTK SPEAKER AMP"
	default n
	help
	  If you say Y, enable MTK_SPEAKER_AMP
	  If the codec has internal speaker, enable this.
	  This is a config for mediatek internal speaker amp.
	  Generally you select "N", if unsupport it.

config MTK_NXP_TFA9890
	bool "MTK NXP TFA9890 SMART PA DRIVER"
	default n
	help
	  If you say Y, enable MTK_NXP_TFA9890 driver.
	  This is 3rd party's speaker amp driver.
	  TFA9890 is one of SmartPa of NXP.
	  It is a DSP connect with I2S.

config MTK_SPKGPIO_REWORK
	bool "MTK SPEAKER GPIO REWORK"
	default n
	help
	  This is only for MTK internal phone only
	  Enable SPKGPIO REWORK check functionality
	  Will choose the correct GPIO for external AMP
	  If you say Y, enable MTK_SPKGPIO_REWORK

config MTK_HP_ANASWITCH
	bool "MTK HEADPHONE ANALOG SWITCH"
	default n
	help
	  This will enable headphone analog switch control
	  for de-pop functionality
	  Only enable this when you have headphone analog switch
	  If you say Y, enable MTK_HP_ANASWITCH

config SND_SOC_MTK_BTCVSD
	bool "MTK BT CVSD ALSA ARICHITECTURE"
	default n
	help
	  If you say Y, enable SND_SOC_MTK_BTCVSD.
	  This is for software BTCVSD. This enable
	  the function for transferring/receiving
	  BT encoded data to/from BT firmware.

config MTK_HDMI_TDM
	bool "MTK HDMI MULTI CHANNEL "
	default n
	help
	  If you say Y, enable MTK_HDMI_TDM.
	  This is for HDMI TDM function.
	  This setting help you to enable
	  HDMI multi channel function with TDM hardware.

config MTK_SND_SOC_NEW_ARCH
	bool "Support new audio architecture"
	select REGMAP_MMIO
	help
	  If you say Y, enable MTK_SND_SOC_NEW_ARCH.
	  Only enable this when you use refactored audio driver architecture.
	  If new chip after mt6757, we will enable this config.
	  Audio driver refactor to common folder and platform folder.

config MTK_AUDIO_TUNNELING_SUPPORT
	bool "Audio playback through dsp"
	select SND_SOC_COMPRESS
	help
	  Only enable this when we have DSP.
	  This makes audio output pass bitstream without any post processing.
	  The decoding process is done in DSP.
	  Select Y to enable MTK_AUDIO_TUNNELING_SUPPORT for DSP playback.

config MTK_AUDIO_SCP_SPKPROTECT_SUPPORT
	bool "speaker protection through dsp"
	help
	  Only enable this when we have DSP.
	  This makes speaker protection processing from dsp side.
	  The process is done in DSP.
	  Select Y to enable CONFIG_MTK_AUDIO_SCP_SPKPROTECT_SUPPORT for DSP playback.
```
